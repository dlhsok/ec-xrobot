/* Includes ------------------------------------------------------------------*/
#include "bsp_hal_tm1652.h"
/* Private macros ------------------------------------------------------------*/
/* Private types -------------------------------------------------------------*/
extern void HAL_usDelay(uint32_t nus);
/* Private constants ---------------------------------------------------------*/
const unsigned char ones[]= {
        0, 1, 1, 2, 1, 2, 2, 3, 1, 2, 2, 3, 2, 3, 3, 4, 
        1, 2, 2, 3, 2, 3, 3, 4, 2, 3, 3, 4, 3, 4, 4, 5, 
        1, 2, 2, 3, 2, 3, 3, 4, 2, 3, 3, 4, 3, 4, 4, 5, 
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        4, 5, 5, 6, 5, 6, 6, 7, 5, 6, 6, 7, 6, 7, 7, 8
};
/* Private variables ---------------------------------------------------------*/
/* Private functions ---------------------------------------------------------*/
void bsp_tm1652_write(uint8_t dat)
{
	uint8_t TB80;
	uint8_t i,dat_bit;
	TB80 = ((ones[dat] & 0x01) == 0);
	//Send data to UART buffer
	TM1652_CLK_L();
	HAL_usDelay(52);
    for(i=0; i<8; i++)
	{
		dat_bit = dat >> i;//(7-i);
		if( ( dat_bit & 0x01 ) == 0x01 )
			TM1652_CLK_H();
		else
			TM1652_CLK_L();
		HAL_usDelay(52);
	}
	if(TB80)
		TM1652_CLK_H();
	else
		TM1652_CLK_L();
	HAL_usDelay(52);
	TM1652_CLK_H();
	HAL_usDelay(52);
}
/* Exported macros -----------------------------------------------------------*/
/* Exported types ------------------------------------------------------------*/
/* Exported constants --------------------------------------------------------*/
/* Exported variables --------------------------------------------------------*/
/* Exported functions --------------------------------------------------------*/
void bsp_tm1652_init(void)
{
	TM1652_CLK_H();
}
void bsp_tm1652_SendData( uint8_t smg[], uint8_t len )
{
	uint8_t i;
	bsp_tm1652_write(0X08);
	for(i=0; i<len; i++)
		bsp_tm1652_write(smg[i]);
}
void bsp_tm1652_SendComm( void )
{
	bsp_tm1652_write(0X18);
	//0011--1248->12设置占空比为 12/16
	// 110--124+1->4设置段驱动电流为 4/8
	//1:设置 7 段 6 位输出 0:设置 8 段 5 位输出
	bsp_tm1652_write(0X3D);//0011 110 1
}






